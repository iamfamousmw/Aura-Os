## Config.in
```kconfig
menu "Aura OS Packages"
source "$BR2_EXTERNAL_AURA_OS_PATH/board/aura/aura-drives/Config.in"
endmenu
```

## board/aura/aura-drives/Config.in
```kconfig
config BR2_PACKAGE_AURA_DRIVES
	bool "Aura Drive Daemon"
	default y
depends on BR2_PACKAGE_HOST_RUSTC
```

## configs/aura_defconfig
```kconfig
BR2_x86_64=y
BR2_x86_64_generic=y
BR2_TOOLCHAIN_BUILDROOT_GLIBC=y
BR2_INIT_SYSTEMD=y
BR2_TARGET_GENERIC_HOSTNAME="Aura-HD"
BR2_TARGET_GENERIC_ISSUE="Aura OS - From Scratch"
BR2_ROOTFS_DEVICE_CREATION_DYNAMIC_EUDEV=y
BR2_ROOTFS_OVERLAY="$(BR2_EXTERNAL_AURA_OS_PATH)/board/aura/rootfs_overlay"
BR2_LINUX_KERNEL=y
BR2_LINUX_KERNEL_LATEST_VERSION=y
BR2_LINUX_KERNEL_DEFCONFIG="x86_64"
BR2_LINUX_KERNEL_NEEDS_HOST_LIBELF=y
BR2_PACKAGE_SYSTEMD=y
BR2_PACKAGE_GNOME_SHELL=y
BR2_PACKAGE_GTK4=y
BR2_PACKAGE_MESA3D=y
BR2_PACKAGE_FLATPAK=y
BR2_PACKAGE_FUSE_OVERLAYFS=y
BR2_PACKAGE_NETWORKMANAGER=y
BR2_PACKAGE_RUSTC=y
BR2_PACKAGE_CARGO=y
BR2_TARGET_ROOTFS_ISO9660=y
BR2_TARGET_ROOTFS_ISO9660_HYBRID=y
BR2_TARGET_ROOTFS_ISO9660_BOOT_MENU="Aura OS"
```
